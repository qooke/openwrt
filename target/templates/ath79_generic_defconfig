## target/templates/ath79_generic_defconfig
```kconfig
CONFIG_TARGET_ath79=y
CONFIG_TARGET_ath79_generic=y
CONFIG_TARGET_MULTI_PROFILE=y
CONFIG_TARGET_DEVICE_ath79_generic_DEVICE_8dev_carambola2=y
CONFIG_TARGET_DEVICE_PACKAGES_ath79_generic_DEVICE_8dev_carambola2=""
```

## target/templates/ath79_nand_defconfig
```kconfig
CONFIG_TARGET_ath79=y
CONFIG_TARGET_ath79_nand=y
CONFIG_TARGET_MULTI_PROFILE=y
CONFIG_TARGET_DEVICE_ath79_nand_DEVICE_netgear_r6100=y
CONFIG_TARGET_DEVICE_PACKAGES_ath79_nand_DEVICE_netgear_r6100="nand-utils"
```

## target/templates/ipq40xx_generic_defconfig
```kconfig
CONFIG_TARGET_ipq40xx=y
CONFIG_TARGET_ipq40xx_generic=y
CONFIG_TARGET_MULTI_PROFILE=y
CONFIG_TARGET_DEVICE_ipq40xx_generic_DEVICE_skspruce_wia3300-20=y
CONFIG_TARGET_DEVICE_PACKAGES_ipq40xx_generic_DEVICE_skspruce_wia3300-20=""
CONFIG_TARGET_DEVICE_ipq40xx_generic_DEVICE_mobipromo_cm520-79f=y
CONFIG_TARGET_DEVICE_PACKAGES_ipq40xx_generic_DEVICE_mobipromo_cm520-79f="nand-utils"
CONFIG_TARGET_DEVICE_ipq40xx_generic_DEVICE_netgear_rbr50=y
CONFIG_TARGET_DEVICE_PACKAGES_ipq40xx_generic_DEVICE_netgear_rbr50="mmc-utils"
```

## target/templates/mediatek_filogic_defconfig
```kconfig
CONFIG_TARGET_mediatek=y
CONFIG_TARGET_mediatek_filogic=y
CONFIG_TARGET_MULTI_PROFILE=y
CONFIG_TARGET_DEVICE_mediatek_filogic_DEVICE_openwrt_one=y
CONFIG_TARGET_DEVICE_PACKAGES_mediatek_filogic_DEVICE_openwrt_one=""
#CONFIG_TARGET_DEVICE_mediatek_filogic_DEVICE_airopi_ax3=y
#CONFIG_TARGET_DEVICE_PACKAGES_mediatek_filogic_DEVICE_airopi_ax3="mmc-utils"
#CONFIG_TARGET_DEVICE_mediatek_filogic_DEVICE_peanutpi_r3s-mini=y
#CONFIG_TARGET_DEVICE_PACKAGES_mediatek_filogic_DEVICE_peanutpi_r3s-mini="mmc-utils"
CONFIG_TARGET_ROOTFS_PARTSIZE=447
```

## target/templates/packages-default_defconfig
```kconfig
CONFIG_DEVEL=y
CONFIG_TOOLCHAINOPTS=y
CONFIG_BUSYBOX_CUSTOM=y
CONFIG_TARGET_PER_DEVICE_ROOTFS=y
CONFIG_AUTOREMOVE=y
# CONFIG_BINUTILS_USE_VERSION_2_44 is not set
CONFIG_BINUTILS_USE_VERSION_2_45=y
CONFIG_BINUTILS_VERSION="2.45.1"
CONFIG_BINUTILS_VERSION_2_45=y
CONFIG_BUSYBOX_CONFIG_DEVMEM=y
CONFIG_BUSYBOX_CONFIG_XXD=y
# CONFIG_GCC_USE_VERSION_14 is not set
CONFIG_GCC_USE_VERSION_15=y
CONFIG_GCC_VERSION="15.2.0"
CONFIG_GCC_VERSION_15=y
# CONFIG_GDB is not set
CONFIG_KERNEL_DEVMEM=y
# CONFIG_KERNEL_WERROR is not set
CONFIG_LUCI_LANG_zh_Hans=y
```

## target/templates/packages-extra_defconfig
```kconfig
CONFIG_PACKAGE_cgi-io=y
CONFIG_PACKAGE_ethtool=y
CONFIG_PACKAGE_fdt-utils=y
CONFIG_PACKAGE_iperf3=y
CONFIG_PACKAGE_kmod-libphy=y
CONFIG_PACKAGE_kmod-mdio-netlink=y
CONFIG_PACKAGE_kmod-mtd-rw=y
CONFIG_PACKAGE_libatomic=y
CONFIG_PACKAGE_libfdt=y
CONFIG_PACKAGE_libiperf3=y
CONFIG_PACKAGE_libiwinfo=y
CONFIG_PACKAGE_libiwinfo-data=y
CONFIG_PACKAGE_liblucihttp=y
CONFIG_PACKAGE_liblucihttp-ucode=y
CONFIG_PACKAGE_luci=y
CONFIG_PACKAGE_luci-app-firewall=y
CONFIG_PACKAGE_luci-app-package-manager=y
CONFIG_PACKAGE_luci-base=y
CONFIG_PACKAGE_luci-i18n-base-zh-cn=y
CONFIG_PACKAGE_luci-i18n-dashboard-zh-cn=y
CONFIG_PACKAGE_luci-i18n-firewall-zh-cn=y
CONFIG_PACKAGE_luci-i18n-package-manager-zh-cn=y
CONFIG_PACKAGE_luci-lib-uqr=y
CONFIG_PACKAGE_luci-light=y
CONFIG_PACKAGE_luci-mod-admin-full=y
CONFIG_PACKAGE_luci-mod-dashboard=y
CONFIG_PACKAGE_luci-mod-network=y
CONFIG_PACKAGE_luci-mod-status=y
CONFIG_PACKAGE_luci-mod-system=y
CONFIG_PACKAGE_luci-proto-ipv6=y
CONFIG_PACKAGE_luci-proto-ppp=y
CONFIG_PACKAGE_luci-theme-bootstrap=y
CONFIG_PACKAGE_mdio-tools=y
CONFIG_PACKAGE_mmc-utils=m
CONFIG_PACKAGE_nand-utils=m
CONFIG_PACKAGE_rpcd=y
CONFIG_PACKAGE_rpcd-mod-file=y
CONFIG_PACKAGE_rpcd-mod-iwinfo=y
CONFIG_PACKAGE_rpcd-mod-luci=y
CONFIG_PACKAGE_rpcd-mod-rrdns=y
CONFIG_PACKAGE_rpcd-mod-ucode=y
CONFIG_PACKAGE_ucode-mod-html=y
CONFIG_PACKAGE_ucode-mod-log=y
CONFIG_PACKAGE_ucode-mod-math=y
CONFIG_PACKAGE_uhttpd=y
CONFIG_PACKAGE_uhttpd-mod-ubus=y
CONFIG_REPRODUCIBLE_DEBUG_INFO=y
```

## target/templates/ramips_mt7620_defconfig
```kconfig
CONFIG_TARGET_ramips=y
CONFIG_TARGET_ramips_mt7620=y
CONFIG_TARGET_MULTI_PROFILE=y
CONFIG_TARGET_DEVICE_ramips_mt7620_DEVICE_aigale_ai-br100=y
CONFIG_TARGET_DEVICE_PACKAGES_ramips_mt7620_DEVICE_aigale_ai-br100=""
CONFIG_TARGET_DEVICE_ramips_mt7620_DEVICE_youku_x2=y
CONFIG_TARGET_DEVICE_PACKAGES_ramips_mt7620_DEVICE_youku_x2="mmc-utils"
CONFIG_PACKAGE_RT2X00_LIB_DEBUGFS=y
```

## target/templates/ramips_mt7621_defconfig
```kconfig
CONFIG_TARGET_ramips=y
CONFIG_TARGET_ramips_mt7621=y
CONFIG_TARGET_MULTI_PROFILE=y
CONFIG_TARGET_DEVICE_ramips_mt7621_DEVICE_dlink_dir-878-a1=y
CONFIG_TARGET_DEVICE_PACKAGES_ramips_mt7621_DEVICE_dlink_dir-878-a1=""
CONFIG_TARGET_DEVICE_ramips_mt7621_DEVICE_h3c_tx1801-plus=y
CONFIG_TARGET_DEVICE_PACKAGES_ramips_mt7621_DEVICE_h3c_tx1801-plus="nand-utils"
```

## target/templates/ramips_mt76x8_defconfig
```kconfig
CONFIG_TARGET_ramips=y
CONFIG_TARGET_ramips_mt76x8=y
CONFIG_TARGET_MULTI_PROFILE=y
CONFIG_TARGET_DEVICE_ramips_mt76x8_DEVICE_xiaomi_mi-router-4a-100m=y
CONFIG_TARGET_DEVICE_PACKAGES_ramips_mt76x8_DEVICE_xiaomi_mi-router-4a-100m=""
CONFIG_TARGET_DEVICE_ramips_mt76x8_DEVICE_hiwifi_hc5661a=y
CONFIG_TARGET_DEVICE_PACKAGES_ramips_mt76x8_DEVICE_hiwifi_hc5661a="mmc-utils"
```
