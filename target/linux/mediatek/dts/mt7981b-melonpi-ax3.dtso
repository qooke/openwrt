// SPDX-License-Identifier: (GPL-2.0 OR MIT)

/dts-v1/;
/plugin/;

/ {
        compatible = "melonpi,ax3", "mediatek,mt7981";

        fragment@0 {
                target = <&uart1>;
                __overlay__ {
                        status = "okay";
                };
        };
};
